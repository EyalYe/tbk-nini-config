## boards/shields/tbk_nini/Kconfig.defconfig
```kconfig
if SHIELD_TBK_NINI_LEFT || SHIELD_TBK_NINI_RIGHT || SHIELD_TBK_NINI_DONGLE

config ZMK_POINTING
    default y

config ZMK_SPLIT
    default y

config ZMK_SPLIT_BLE_CENTRAL_PERIPHERALS
    default 2

config ZMK_SPLIT_BLE
    default y

config BT_MAX_CONN
    default 7

config BT_MAX_PAIRED
    default 7

endif


if SHIELD_TBK_NINI_DONGLE
config ZMK_KEYBOARD_NAME
    default "TBK_NINI_D"

config ZMK_SPLIT_ROLE_CENTRAL
    default y

# Set this to ZMK_SPLIT_BLE_CENTRAL_PERIPHERALS + your desired number of BT profiles (default is 5)
config BT_MAX_CONN
    default 7

# Set this to the same number as BT_MAX_CONN
config BT_MAX_PAIRED
    default 7
endif

if SHIELD_TBK_NINI_RIGHT

  config SPI
    default y

endif
```

## boards/shields/tbk_nini/Kconfig.shield
```kconfig
# No whitespace after the comma or in the keyboard name!
config SHIELD_TBK_NINI_DONGLE
    def_bool $(shields_list_contains,tbk_nini_dongle)

config SHIELD_TBK_NINI_LEFT
    def_bool $(shields_list_contains,tbk_nini_left)

config SHIELD_TBK_NINI_RIGHT
    def_bool $(shields_list_contains,tbk_nini_right)
```
