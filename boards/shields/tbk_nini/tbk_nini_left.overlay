/*
 * Copyright (c) 2020 Pete Johanson
 *
 * SPDX-License-Identifier: MIT
 */

#include "tbk_nini.dtsi"

&kscan0 {
    col-gpios
      = <&pro_micro 8 GPIO_ACTIVE_HIGH>
      , <&pro_micro 7 GPIO_ACTIVE_HIGH>
      , <&pro_micro 6 GPIO_ACTIVE_HIGH>
      , <&pro_micro 10 GPIO_ACTIVE_HIGH>
      , <&pro_micro 20 GPIO_ACTIVE_HIGH>
      , <&pro_micro 19 GPIO_ACTIVE_HIGH>
      ;
};

&trackball_listener{
  status = "okay";
};

